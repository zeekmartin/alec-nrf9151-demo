## firmware/build/Kconfig/boards/Kconfig.defconfig
```kconfig
# Load Zephyr board defconfig descriptions.
osource "C:/ncs/v2.9.2/zephyr/boards/nordic/nrf9151dk/Kconfig.defconfig"
```

## firmware/build/firmware/Kconfig/boards/Kconfig
```kconfig
# Load Zephyr board Kconfig descriptions.
osource "C:/ncs/v2.9.2/zephyr/boards/nordic/nrf9151dk/Kconfig"
```
